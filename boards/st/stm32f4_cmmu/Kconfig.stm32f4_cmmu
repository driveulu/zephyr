## boards/st/stm32f4_cmmu/Kconfig.stm32f4_cmmu
```kconfig
# Copyright (c) 2016 Linaro Limited.
# SPDX-License-Identifier: Apache-2.0

config BOARD_STM32F4_CMMU
	select SOC_STM32F405XX
```

## boards/st/stm32f4_cmmu/board.yml
```yaml
board:
  name: stm32f4_cmmu
  full_name: STM32F4 Discovery
  vendor: st
  socs:
    - name: stm32f405xx
```
